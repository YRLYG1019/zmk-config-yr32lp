## Kconfig
```kconfig
config INPUT_PIM447
    bool "Pimoroni PIM447 trackball input driver"
    default y
    depends on DT_HAS_PIMORONI_PIM447_ENABLED
    depends on INPUT
    select I2C

config INPUT_PIM447_LOG_RAW
    bool "Log raw PIM447 / AZ1UBALL counts (for tuning)"
    default n
    depends on INPUT_PIM447 && LOG
    help
      Log one "RAW,..." line per poll with movement: the four raw direction
      counts and each processing step. Use with the zmk-usb-logging snippet.
```

## dts/bindings/input/pimoroni,pim447.yaml
```yaml
description: |
  Pimoroni PIM447 Trackball Breakout (I2C, default address 0x0A).
  Reports INPUT_REL_X / INPUT_REL_Y and INPUT_BTN_0 (ball click).

compatible: "pimoroni,pim447"

include: i2c-device.yaml

properties:
  poll-interval-ms:
    type: int
    default: 10
    description: Polling interval in milliseconds.

  scale:
    type: int
    default: 2
    description: Same meaning as QMK PIMORONI_TRACKBALL_SCALE.

  rotation:
    type: int
    default: 0
    enum: [0, 90, 180, 270]
    description: Same direction definition as QMK POINTING_DEVICE_ROTATION_xx.

  invert-x:
    type: boolean

  invert-y:
    type: boolean

  linear:
    type: boolean
    description: Disable QMK-style quadratic acceleration.

  debounce-polls:
    type: int
    default: 2
    description: Number of polls to ignore motion after the ball is released.

  smoothing:
    type: int
    default: 1
    description: |
      Spread each movement over several polls. Every poll outputs 1/N
      (rounded up) of the movement not yet reported. 1 = off.

  led-rgbw:
    type: uint8-array
    default: [0, 0, 0, 0]
    description: Trackball LED color (R, G, B, W) set at startup.

  az1uball:
    type: boolean
    description: |
      The device is an AZ1UBALL. Send command 0x90 (normal count mode) at
      startup, so a previously enabled acceleration mode is turned off.

  az1uball-accel:
    type: boolean
    description: |
      AZ1UBALL only. Send command 0x91 at startup to enable the ball's own
      acceleration mode (counts 1/2/3 per edge depending on rotation speed).
      It also weights jitter on the opposite sensor, which can move the
      cursor backwards; prefer accel-window-polls.

  accel-window-polls:
    type: int
    default: 0
    description: |
      Driver-side acceleration. Speed is the count over the last N polls,
      measured after subtracting opposite directions. 0 = off (max 16).

  accel-step-percent:
    type: int
    default: 100
    description: Multiplier increase per count above 1 in the window.

  accel-max-percent:
    type: int
    default: 300
    description: Upper limit of the acceleration multiplier.

  reject-reverse-ms:
    type: int
    default: 0
    description: |
      Per axis, hold counts opposite to the last movement direction if they
      arrive within this many ms of the last accepted count (sensor jitter
      on the opposite sensor). Held counts are dropped when movement in the
      original direction continues, and released together once they reach
      reverse-counts (a real reversal). 0 = off.

  reverse-counts:
    type: int
    default: 3
    description: Opposite counts needed to accept a reversal within reject-reverse-ms.
```
